## components/lvgl_port/Kconfig
```kconfig
menu "LVGL port"

    config LVGL_PORT_BUFFER_LINES
        int "Partial draw buffer height in lines"
        range 8 160
        default 40
        help
            One render buffer of lines x panel width x 2 bytes is allocated in
            internal DMA-capable RAM, on top of the panel driver's own staging
            buffer. 40 lines at 240 px costs 19200 bytes; a taller buffer means
            fewer SPI transactions per frame, a shorter one saves RAM.

    config LVGL_PORT_TASK_PRIORITY
        int "LVGL handler task priority"
        range 1 20
        default 4

    config LVGL_PORT_TASK_STACK
        int "LVGL handler task stack size (bytes)"
        range 3072 32768
        default 8192

    config LVGL_PORT_ARROW_NAV
        bool "Arrow keys move focus inside the LVGL group"
        default y
        help
            LVGL 9 moves group focus only for LV_KEY_NEXT or LV_KEY_PREV.
            Arrow keys are delivered to the focused object as LV_EVENT_KEY,
            which plain buttons ignore, so a 5-way keypad appears to have a
            working OK key only. This option remaps UP/LEFT to PREV and
            DOWN/RIGHT to NEXT so every screen can be navigated.
            Disable it for screens whose widgets consume arrow keys directly,
            such as sliders, spinboxes and scrollable lists.

    config LVGL_PORT_TASK_CORE
        int "LVGL handler task core (-1 for no affinity)"
        range -1 1
        default -1

endmenu
```

## components/stm32_isp/Kconfig
```kconfig
menu "STM32 offline programmer"

    choice STM32_PROGRAMMER_BACKEND
        prompt "Programming interface"
        default STM32_PROGRAMMER_SWD
        config STM32_PROGRAMMER_SWD
            bool "SWD (STM32F103 single-bank)"
        config STM32_PROGRAMMER_USART
            bool "Factory USART bootloader (legacy)"
    endchoice

    config STM32_SWDIO_GPIO
        int "SWDIO GPIO (target PA13)"
        range 0 48
        default 19

    config STM32_SWCLK_GPIO
        int "SWCLK GPIO (target PA14)"
        range 0 48
        default 20

    config STM32_SWD_DELAY_US
        int "SWD half-period delay (microseconds)"
        range 1 20
        default 1

    config STM32_SWD_MANUAL_RESET
        bool "Guide the operator through STM32 reset on the display"
        depends on STM32_PROGRAMMER_SWD
        default n
        help
            Keep enabled only when the target RESET button must be operated by
            hand. Disable it for the one-click automatic SWD flow.

    config STM32_SWD_WIRED_RESET
        bool "Drive STM32 NRST from an ESP32 GPIO"
        depends on STM32_PROGRAMMER_SWD
        default n
        help
            Drive the configured NRST GPIO during automatic SWD programming.
            Leave disabled when the target RESET pin is not connected. In that
            case the programmer attaches to the running target and issues a
            Cortex-M SYSRESETREQ after verification.

    config STM32_BOOT0_GPIO
        int "STM32 BOOT0 GPIO"
        range 0 48
        default 15

    config STM32_NRST_GPIO
        int "STM32 NRST GPIO"
        range 0 48
        default 16

    config STM32_UART_BAUD
        int "Bootloader baud rate"
        default 57600
        help
            The STM32 system bootloader autodetects 9600..115200. 57600 is the
            value verified by the reference project.

    config STM32_BYTE_PACING_MS
        int "Delay between transmitted bytes (ms)"
        range 0 5
        default 1
        help
            The STM32 bootloader is sensitive to back-to-back UART frames.
            One millisecond per byte is the verified setting. Set 0 only after
            confirming a faster rate works on the target.

    config STM32_DEFAULT_BASE
        hex "Default flash base address"
        default 0x08000000

    config STM32_DEFAULT_PAGE_SIZE
        int "Default erase page size (bytes)"
        default 2048
        help
            STM32L4/L0: 2048. STM32F1/F3: 1024 or 2048 depending on density.
            STM32F4 sectors are larger; set the real value for that family.

    config STM32_ERASE_CHUNK
        int "Pages per erase command"
        range 1 16
        default 4

    config STM32_MASS_ERASE_FALLBACK
        bool "Fall back to a whole-chip erase when the page list is rejected"
        default y
        help
            When the target refuses every page index (usually because the
            selected page size does not match the part), the driver can issue
            the AN3155 mass-erase command instead. That command erases the
            entire flash, including the option bytes region on some parts, so
            enable it only for parts you intend to fully reprogram.

    config STM32_VERIFY_AFTER_WRITE
        bool "Read back and compare every page"
        default y

endmenu
```

## components/uart_link/Kconfig
```kconfig
menu "Shared UART link (payload and STM32 ISP)"

    config UART_LINK_PORT
        int "UART peripheral number"
        range 2 2
        default 2
        help
            UART2 and GPIO19/20 are shared by normal bidirectional communication
            and the STM32 bootloader. Normal RX/TX is paused for the complete
            ISP job and resumes after the job restores the normal baud rate.

    config UART_LINK_TX_GPIO
        int "UART TX GPIO (ESP32-S3 output)"
        range 0 48
        default 19

    config UART_LINK_RX_GPIO
        int "UART RX GPIO (ESP32-S3 input)"
        range 0 48
        default 20

    config UART_LINK_BAUD
        int "Baud rate"
        default 115200

    config UART_LINK_APPEND_CRLF
        bool "Append CR LF after every payload"
        default y
        help
            Most text-oriented slaves expect a line terminator. Disable it
            for binary payloads that must be sent byte-exact.

endmenu
```

## main/Kconfig.projbuild
```kconfig
menu "ST7789 display"

    config LCD_PIN_SCLK
        int "SCL / SCK GPIO"
        range 0 48
        default 12

    config LCD_PIN_MOSI
        int "SDA / MOSI GPIO"
        range 0 48
        default 11

    config LCD_PIN_CS
        int "CS GPIO (-1 for permanently grounded CS)"
        range -1 48
        default 10

    config LCD_PIN_DC
        int "A0 / AO / DC GPIO"
        range 0 48
        default 9

    config LCD_PIN_RESET
        int "RESET GPIO (-1 for software reset)"
        range -1 48
        default 8

    config LCD_PIN_BL
        int "Backlight control GPIO (-1 for external backlight power)"
        range -1 48
        default -1
        help
            Use a module BL logic input or an external transistor/MOSFET.
            A GPIO is a control signal, not a backlight power supply.
            PWM reserves LEDC low-speed timer 0 and channel 0.

    config LCD_BL_ACTIVE_LOW
        bool "Backlight control is active low"
        depends on LCD_PIN_BL >= 0
        default n

    config LCD_SPI_CLOCK_MHZ
        int "SPI clock (MHz; try 10 or 20 with jumper wires)"
        range 1 40
        default 20

    choice LCD_ROTATION
        prompt "Display rotation"
        default LCD_ROTATION_0

        config LCD_ROTATION_0
            bool "0 degrees, 240x320"
        config LCD_ROTATION_90
            bool "90 degrees, 320x240"
        config LCD_ROTATION_180
            bool "180 degrees, 240x320"
        config LCD_ROTATION_270
            bool "270 degrees, 320x240"
    endchoice

    config LCD_BGR_ORDER
        bool "BGR element order (toggle if red and blue are reversed)"
        default n

    config LCD_INVERT_COLORS
        bool "Enable panel inversion (INVON)"
        default n
        help
            Sends the ST7789 INVON command, which complements every colour.
            Leave it off unless the panel really needs it: with inversion
            wrongly enabled, red is shown as cyan (light blue), green as
            magenta (purple) and blue as yellow, and white becomes black.
            Only a module that renders a photo-negative picture while this
            option is off really needs it enabled.

endmenu

menu "Navigation buttons"

    config BUTTON_PIN_UP
        int "UP button GPIO"
        range 0 48
        default 4

    config BUTTON_PIN_DOWN
        int "DOWN button GPIO"
        range 0 48
        default 5

    config BUTTON_PIN_LEFT
        int "LEFT button GPIO"
        range 0 48
        default 6

    config BUTTON_PIN_RIGHT
        int "RIGHT button GPIO"
        range 0 48
        default 13

    config BUTTON_PIN_OK
        int "OK / confirm button GPIO"
        range 0 48
        default 14

    config BUTTON_DEBOUNCE_MS
        int "Press and release debounce (ms)"
        range 10 100
        default 30

endmenu

menu "Demo application"

    choice DEMO_APP
        prompt "Demo application"
        default DEMO_APP_LVGL

        config DEMO_APP_LVGL
            bool "LVGL user interface"
            help
                Bind LVGL to the panel through components/lvgl_port and show a
                small keypad-driven UI. LVGL adds roughly 100 KB of static and
                heap RAM; see the LVGL configuration menu for the pool size.

        config DEMO_APP_RAW
            bool "Native ST7789 diagnostics and movable square"

    endchoice

endmenu
```
